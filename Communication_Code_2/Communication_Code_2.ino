#include <esp_now.h>
#include <WiFi.h>
#include <Wire.h>
#include <Adafruit_GFX.h>
#include <Adafruit_SSD1306.h>
#define BUZZER 16
#include <Fonts/FreeSerif12pt7b.h>
// Change THIS for each ESP (put the OTHER ESP MAC here)
uint8_t peerAddress[] = {0xD4, 0x8C, 0x49, 0x56, 0xDE, 0xB4};
 



/////////////////////////////////////////////////////////////7777


// 'icon_first', 64x66px
const unsigned char epd_bitmap_icon_first [] PROGMEM = {
	0x00, 0x00, 0x00, 0x00, 0x00, 0x00, 0x00, 0x00, 0x00, 0x00, 0x00, 0x00, 0x00, 0x00, 0x00, 0x00, 
	0x00, 0x00, 0x00, 0x00, 0x00, 0x00, 0x00, 0x00, 0x00, 0x00, 0x00, 0x00, 0x00, 0x00, 0x00, 0x00, 
	0x00, 0x00, 0x00, 0x00, 0x00, 0x00, 0x00, 0x00, 0x00, 0x00, 0x00, 0x00, 0x00, 0x00, 0x00, 0x00, 
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	0x00, 0x00, 0x00, 0x00, 0x00, 0x00, 0x00, 0x00, 0x00, 0x00, 0x00, 0x00, 0x00, 0x00, 0x00, 0x00
};



///////////////////////////////////////////////////////////////////////////
// 'Icon_second', 64x66px
const unsigned char epd_bitmap_Icon_second [] PROGMEM = {
	0x00, 0x00, 0x00, 0x00, 0x00, 0x00, 0x00, 0x00, 0x00, 0x00, 0x00, 0x00, 0x00, 0x00, 0x00, 0x00, 
	0x00, 0x00, 0x00, 0x00, 0x00, 0x00, 0x00, 0x00, 0x00, 0x00, 0x00, 0x00, 0x00, 0x00, 0x00, 0x00, 
	0x00, 0x00, 0x00, 0x00, 0x00, 0x00, 0x00, 0x00, 0x00, 0x00, 0x00, 0x00, 0x00, 0x00, 0x00, 0x00, 
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	0x00, 0x00, 0x00, 0x00, 0x00, 0x00, 0x00, 0x00, 0x00, 0x00, 0x00, 0x00, 0x00, 0x00, 0x00, 0x00
};


//////////////////////////////////////////////////////////////


// 'icon_third', 64x66px
const unsigned char epd_bitmap_icon_third [] PROGMEM = {
	0x00, 0x00, 0x00, 0x00, 0x00, 0x00, 0x00, 0x00, 0x00, 0x00, 0x00, 0x00, 0x00, 0x00, 0x00, 0x00, 
	0x00, 0x00, 0x00, 0x00, 0x00, 0x00, 0x00, 0x00, 0x00, 0x00, 0x00, 0x00, 0x00, 0x00, 0x00, 0x00, 
	0x00, 0x00, 0x00, 0x00, 0x00, 0x00, 0x00, 0x00, 0x00, 0x00, 0x00, 0x00, 0x00, 0x00, 0x00, 0x00, 
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	0x00, 0x00, 0x00, 0x00, 0x00, 0x00, 0x00, 0x00, 0x00, 0x00, 0x00, 0x00, 0x00, 0x00, 0x00, 0x00
};





/////////////////////////////////////

// 'iconESP_NOW_Project', 64x66px
const unsigned char epd_bitmap_iconESP_NOW_Project [] PROGMEM = {
	0x00, 0x00, 0x00, 0x00, 0x00, 0x00, 0x00, 0x00, 0x00, 0x00, 0x00, 0x00, 0x00, 0x00, 0x00, 0x00, 
	0x00, 0x00, 0x00, 0x00, 0x00, 0x00, 0x00, 0x00, 0x00, 0x00, 0x00, 0x00, 0x00, 0x00, 0x00, 0x00, 
	0x00, 0x00, 0x00, 0x00, 0x00, 0x00, 0x00, 0x00, 0x00, 0x00, 0x00, 0x00, 0x00, 0x00, 0x00, 0x00, 
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	0x00, 0x00, 0x00, 0x00, 0x00, 0x00, 0x00, 0x00, 0x00, 0x00, 0x00, 0x00, 0x00, 0x00, 0x00, 0x00
};



//////////////////////////////////////////

// ===== MORSE SYSTEM =====

String currentMorse = "";
String morseMessage = "";

struct MorseMap {
  const char* code;
  char letter;
};

MorseMap morseTable[] = {
  {".-", 'A'}, {"-...", 'B'}, {"-.-.", 'C'}, {"-..", 'D'},
  {".", 'E'}, {"..-.", 'F'}, {"--.", 'G'}, {"....", 'H'},
  {"..", 'I'}, {".---", 'J'}, {"-.-", 'K'}, {".-..", 'L'},
  {"--", 'M'}, {"-.", 'N'}, {"---", 'O'}, {".--.", 'P'},
  {"--.-", 'Q'}, {".-.", 'R'}, {"...", 'S'}, {"-", 'T'},
  {"..-", 'U'}, {"...-", 'V'}, {".--", 'W'}, {"-..-", 'X'},
  {"-.--", 'Y'}, {"--..", 'Z'}
};

char decodeMorse(String code) {
  for (int i = 0; i < sizeof(morseTable)/sizeof(morseTable[0]); i++) {
    if (code == morseTable[i].code) {
      return morseTable[i].letter;
    }
  }
  return '?';
}



// Data structure (MUST be identical on both)
typedef struct struct_message {
  char message[32];
} struct_message;



struct_message sendData;
struct_message recData;

// Peer info
esp_now_peer_info_t peerInfo;



// ✅ NEW SEND CALLBACK (UPDATED)
void OnDataSent(const wifi_tx_info_t *info, esp_now_send_status_t status) {
  Serial.print("Send Status: ");
  Serial.println(status == ESP_NOW_SEND_SUCCESS ? "Success" : "Fail");
}

// ✅ NEW RECEIVE CALLBACK (UPDATED)
void OnDataRecv(const esp_now_recv_info_t *info, const uint8_t *incomingData, int len) {
  memcpy(&recData, incomingData, sizeof(recData));

  Serial.println("=== RECEIVED ===");
  Serial.print("Text: ");
  Serial.println(recData.message);

  delay(200);
  digitalWrite(18, HIGH);
  ledcWriteTone(BUZZER,2000);
  delay(200);
  ledcWriteTone(BUZZER,0);
  digitalWrite(18,LOW);

  Serial.println();
}


Adafruit_SSD1306 display(128,64,&Wire,-1);
 ////////////////////////setup ////////////////////////
void setup() {
//Buzzer setup
ledcAttach(BUZZER,2000,8);
//Button
pinMode(4,INPUT_PULLUP);
pinMode(5,INPUT_PULLUP);
pinMode(32,INPUT_PULLUP);
pinMode(26,INPUT_PULLUP);

//OLED SSD1306 setup
 
  Wire.begin(21,22);
  display.begin(SSD1306_SWITCHCAPVCC,0x3C);
   display.setTextColor(SSD1306_WHITE);

  //jump start the OLED
  digitalWrite(4,HIGH);
  delay(50);
  digitalWrite(4,LOW);


 	display.setTextColor(SSD1306_WHITE);
  display.setFont(&FreeSerif12pt7b);
for(int i=0; i<3; i++){

  // Show startup first image
  display.clearDisplay();
  display.drawBitmap(0, 0, epd_bitmap_icon_first, 64, 64, WHITE);
display.setCursor(70, 20);  
 	display.println("ESP");  
	display.setCursor(85, 35); 
	display.println("-");  
	display.setCursor(64, 55); 
	display.println("NOW");  
  display.display();
  delay(500);
  //Show startup second image
  display.clearDisplay();
  display.drawBitmap(0, 0, epd_bitmap_Icon_second, 64, 64, WHITE);
display.setCursor(70, 20);  
 	display.println("ESP");  
	display.setCursor(85, 35); 
	display.println("-");  
	display.setCursor(64, 55); 
	display.println("NOW"); 
  display.display();
  delay(500);
  //Show startup second image
  display.clearDisplay();
  display.drawBitmap(0, 0, epd_bitmap_icon_third, 64, 64, WHITE);
	display.setCursor(70, 20); 
display.println("ESP");  
	display.setCursor(85, 35); 
	display.println("-");  
	display.setCursor(64, 55); 
	display.println("NOW");  
  display.display();
  delay(500);
  //Show startup third image
  display.clearDisplay();
  display.drawBitmap(0, 0, epd_bitmap_iconESP_NOW_Project, 64, 64, WHITE);
	display.setCursor(70, 20);  
 	display.println("ESP");  
	display.setCursor(85, 35); 
	display.println("-");  
	display.setCursor(64, 55); 
	display.println("NOW");  
  display.display();
  delay(500);
}
display.setFont(); 
//ESP NOW setup 
  Serial.begin(115200);
  pinMode(18, OUTPUT);
	pinMode(17, OUTPUT);
  WiFi.mode(WIFI_STA);

  if (esp_now_init() != ESP_OK) {
    Serial.println("ESP-NOW Init Failed");
    return;
  }

  // Register BOTH callbacks
  esp_now_register_send_cb(OnDataSent);
  esp_now_register_recv_cb(OnDataRecv);

  // Add peer
  memcpy(peerInfo.peer_addr, peerAddress, 6);
  peerInfo.channel = 0;
  peerInfo.encrypt = false;

  if (esp_now_add_peer(&peerInfo) != ESP_OK) {
    Serial.println("Failed to add peer");
    return;
  }
}


//////void loop//////
void loop(){

//write mode
	if((digitalRead(26)==LOW) && (digitalRead(5)== LOW)){
		delay(200);
		if((digitalRead(26)==LOW) && (digitalRead(5)== LOW)){
			 morseMessage = "";
      currentMorse = "";
        sendData.message[0] = '\0';  // clear buffer

			//blue LED hig 
			digitalWrite(17,HIGH);
			while(digitalRead(32)==HIGH){

// Dot (button 35)
if (digitalRead(26) == LOW) {
  delay(170);
  if (digitalRead(26) == LOW) {
    currentMorse += ".";
  }
}

// Dash (button 25)
if (digitalRead(5) == LOW) {
  delay(170);
  if (digitalRead(5) == LOW) {
    currentMorse += "-";
  }
}

// Decode (button 4)
if (digitalRead(4) == LOW) {
  delay(170);
  if (digitalRead(4) == LOW) {

    char letter = decodeMorse(currentMorse);
    morseMessage += letter;

    // Save to sendData (what will be sent)
    morseMessage.toCharArray(sendData.message, 32);

    currentMorse = ""; // reset for next letter
  }
}


display.clearDisplay();

// Received
display.setCursor(0, 0);
display.setTextSize(2);
display.println("RECEIVED:");
display.setTextSize(1);
display.println(recData.message);

// Sent
display.setCursor(0, 32);
display.setTextSize(2);
display.println("SENT:");
display.setTextSize(1);
display.println(morseMessage);

// Morse (small, right side)
display.setCursor(80, 32);
display.setTextSize(1);
display.println(currentMorse);

display.display();
	}
	digitalWrite(17,LOW);
	}
	}

  if(digitalRead(4)==LOW){
    delay(200);
   if(digitalRead(4)==LOW){

  
 //input.toCharArray(sendData.message, 32);
 esp_now_send(peerAddress, (uint8_t *) &sendData, sizeof(sendData));
 Serial.println("=== SENT ===");
  }
}

//usual display, end of write mode
display.clearDisplay();

display.setCursor(0, 0);
display.setTextSize(2);
display.println("RECEIVED:");
display.setTextSize(1);
display.println(recData.message);

display.setCursor(0, 32);
display.setTextSize(2);
display.println("SENT:");
display.setTextSize(1);
display.println(sendData.message);

display.display();
} 

